# STM32F100xx register map
File version: 1.1
Registers are 32-bit, read-write, reset 0x0 unless marked. A register's access mark holds for its fields unless they carry their own. Offsets are from the block's base; lines under a group give offsets from that group; [hi:lo] are bit positions; {n}, {i} and the like mark numbered series; 'fields as' and 'values as' point back to an identical list; <NAME> marks a mode.

## Memory map
0x40000000 TIM2 size 0x400 — General purpose timer
0x40000400 TIM3 size 0x400
0x40000800 TIM4 size 0x400
0x40000C00 TIM5 size 0x400
0x40001000 TIM6 size 0x400 — Basic timer
0x40001400 TIM7 size 0x400
0x40001800 TIM12 size 0x400 — General purpose timer
0x40001C00 TIM13 size 0x400 — General purpose timer
0x40002000 TIM14 size 0x400
0x40002800 RTC size 0x400 — Real time clock
0x40002C00 WWDG size 0x400 — Window watchdog
0x40003000 IWDG size 0x400 — Independent watchdog
0x40003800 SPI2 size 0x400
0x40003C00 SPI3 size 0x400
0x40004400 USART2 size 0x400
0x40004800 USART3 size 0x400
0x40004C00 UART4 size 0x400 — Universal asynchronous receiver transmitter
0x40005000 UART5 size 0x400 — Universal asynchronous receiver transmitter
0x40005400 I2C1 size 0x400 — Inter integrated circuit
0x40005800 I2C2 size 0x400
0x40006C04 BKP size 0x400 — Backup registers
0x40007000 PWR size 0x400 — Power control
0x40007400 DAC size 0x400 — Digital to analog converter
0x40007800 CEC size 0x400 — HDMI-CEC controller
0x40010000 AFIO size 0x400 — Alternate function I/O
0x40010400 EXTI size 0x400
0x40010800 GPIOA size 0x400 — General purpose I/O
0x40010C00 GPIOB size 0x400
0x40011000 GPIOC size 0x400
0x40011400 GPIOD size 0x400
0x40011800 GPIOE size 0x400
0x40011C00 GPIOF size 0x400
0x40012000 GPIOG size 0x400
0x40012400 ADC1 size 0x400 — Analog to digital converter
0x40012C00 TIM1 size 0x400 — Advanced timer
0x40013000 SPI1 size 0x400 — Serial peripheral interface
0x40013800 USART1 size 0x400 — Universal synchronous asynchronous receiver transmitter
0x40014000 TIM15 size 0x400 — General purpose timers
0x40014400 TIM16 size 0x400 — General-purpose-timers
0x40014800 TIM17 size 0x400
0x40020000 DMA1 size 0x400 — DMA controller
0x40020400 DMA2 size 0x400
0x40021000 RCC size 0x400 — Reset and clock control
0x40022000 FLASH size 0x400
0x40023000 CRC size 0x400 — CRC calculation unit
0xA0000000 FSMC size 0x1000 — Flexible static memory controller
0xE000E000 NVIC size 0x1001 — Nested Vectored Interrupt Controller
0xE0042000 DBG size 0x400 — Debug support

## Interrupts
0 WWDG_IRQ (WWDG) — Window Watchdog interrupt
1 PVD_IRQ (PWR) — PVD through EXTI line detection interrupt
2 TAMPER_STAMP_IRQ (EXTI) — Tamper and TimeStamp through EXTI line interrupts
3 RTC_WKUP_IRQ (RTC) — RTC Wakeup through EXTI line interrupt
4 FLASH_IRQ (FLASH) — Flash global interrupt
5 RCC_IRQ (RCC) — RCC global interrupt
6 EXTI0_IRQ (EXTI) — EXTI Line0 interrupt
7 EXTI1_IRQ (EXTI) — EXTI Line1 interrupt
8 EXTI2_IRQ (EXTI) — EXTI Line2 interrupt
9 EXTI3_IRQ (EXTI) — EXTI Line3 interrupt
10 EXTI4_IRQ (EXTI) — EXTI Line4 interrupt
11 DMA1_Channel1_IRQ (DMA1) — DMA1 Channel1 global interrupt
12 DMA1_Channel2_IRQ (DMA1) — DMA1 Channel2 global interrupt
13 DMA1_Channel3_IRQ (DMA1) — DMA1 Channel3 global interrupt
14 DMA1_Channel4_IRQ (DMA1) — DMA1 Channel4 global interrupt
15 DMA1_Channel5_IRQ (DMA1) — DMA1 Channel5 global interrupt
16 DMA1_Channel6_IRQ (DMA1) — DMA1 Channel6 global interrupt
17 DMA1_Channel7_IRQ (DMA1) — DMA1 Channel7 global interrupt
18 ADC_IRQ (ADC1) — ADC1 global interrupt
23 EXTI9_5_IRQ (EXTI) — EXTI Line[9:5] interrupts
24 TIM1_BRK_TIM15_IRQ (TIM1, TIM15) — TIM1 Break interrupt and TIM15 global interrupt
25 TIM1_UP_TIM16_IRQ (TIM1, TIM16) — TIM1 Update interrupt and TIM16 global interrupt
26 TIM1_TRG_COM_TIM17_IRQ (TIM1, TIM17) — TIM1 Trigger and Commutation interrupts and TIM17 global interrupt
27 TIM1_CC_IRQ (TIM1) — TIM1 Capture Compare interrupt
28 TIM2_IRQ (TIM2) — TIM2 global interrupt
29 TIM3_IRQ (TIM3) — TIM3 global interrupt
30 TIM4_IRQ (TIM4) — TIM4 global interrupt
31 I2C1_EV_IRQ (I2C1) — I2C1 event interrupt
32 I2C1_ER_IRQ (I2C1) — I2C1 error interrupt
33 I2C2_EV_IRQ (I2C2) — I2C2 event interrupt
34 I2C2_ER_IRQ (I2C2) — I2C2 error interrupt
35 SPI1_IRQ (SPI1) — SPI1 global interrupt
36 SPI2_IRQ (SPI2) — SPI2 global interrupt
37 USART1_IRQ (USART1) — USART1 global interrupt
38 USART2_IRQ (USART2) — USART2 global interrupt
39 USART3_IRQ (USART3) — USART3 global interrupt
40 EXTI15_10_IRQ (EXTI) — EXTI Line[15:10] interrupts
41 RTCAlarm_IRQ (RTC) — RTC Alarms through EXTI line interrupt
42 CEC_IRQ (CEC) — CEC global interrupt
43 TIM12_IRQ (TIM12) — TIM12 global interrupt
44 TIM13_IRQ (TIM13, TIM14) — TIM13 global interrupt
48 FSMC_IRQ (FSMC) — FSMC global interrupt
50 TIM5_IRQ (TIM5) — TIM5 global interrupt
51 SPI3_IRQ (SPI3) — SPI3 global interrupt
52 UART4_IRQ (UART4) — UART4 global interrupt
53 UART5_IRQ (UART5) — UART5 global interrupt
54 TIM6_DAC_IRQ (TIM6, DAC) — TIM6 global and DAC underrun interrupts
55 TIM7_IRQ (TIM7) — TIM7 global interrupt
56 DMA2_Channel1_IRQ (DMA2) — DMA2 Channel1 global interrupt
57 DMA2_Channel2_IRQ (DMA2) — DMA2 Channel2 global interrupt
58 DMA2_Channel3_IRQ (DMA2) — DMA2 Channel3 global interrupt
59 DMA2_Channel4_5_IRQ (DMA2) — DMA2 Channel4 and DMA2 Channel5 global interrupt
